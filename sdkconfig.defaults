## sdkconfig.defaults
```kconfig
CONFIG_COMPILER_CXX_RTTI=y

CONFIG_ESP_DEFAULT_CPU_FREQ_MHZ_240=y
CONFIG_ESP_DEFAULT_CPU_FREQ_MHZ=240

CONFIG_ESP32_DEFAULT_CPU_FREQ_240=y
CONFIG_ESP32_DEFAULT_CPU_FREQ_MHZ=240

CONFIG_ESP_MAIN_TASK_STACK_SIZE=8192

CONFIG_LWIP_LOCAL_HOSTNAME="Charlotte Aviation | Remote"
```
